## configs/beagle_xm_hf_full_defconfig
```kconfig
BR2_arm=y
BR2_cortex_a8=y
BR2_WGET="wget --passive-ftp -nd -t 3 --no-check-certificate"
BR2_JLEVEL=12
BR2_TOOLCHAIN_EXTERNAL=y
BR2_TOOLCHAIN_EXTERNAL_CUSTOM=y
BR2_TOOLCHAIN_EXTERNAL_PATH="/opt/arm-omaphf-linux-gnueabi"
BR2_TOOLCHAIN_EXTERNAL_CUSTOM_PREFIX="omaphf"
BR2_TOOLCHAIN_EXTERNAL_CUSTOM_GLIBC=y
# BR2_TOOLCHAIN_EXTERNAL_INET_RPC is not set
BR2_TOOLCHAIN_EXTERNAL_CXX=y
BR2_ENABLE_LOCALE_PURGE=y
BR2_ENABLE_LOCALE_WHITELIST="C en_US"
BR2_TARGET_GENERIC_HOSTNAME="beagleboard-xm"
BR2_TARGET_GENERIC_ISSUE="Welcome to BeagleBoard-xM"
BR2_ROOTFS_DEVICE_CREATION_DYNAMIC_UDEV=y
BR2_TARGET_GENERIC_GETTY_PORT="ttyO2"
BR2_PACKAGE_BUSYBOX_SHOW_OTHERS=y
BR2_PACKAGE_ALSA_UTILS=y
BR2_PACKAGE_ALSA_UTILS_ALSACONF=y
BR2_PACKAGE_ALSA_UTILS_AMIDI=y
BR2_PACKAGE_ALSA_UTILS_AMIXER=y
BR2_PACKAGE_ALSA_UTILS_APLAY=y
BR2_PACKAGE_ALSA_UTILS_IECSET=y
BR2_PACKAGE_ALSA_UTILS_ACONNECT=y
BR2_PACKAGE_ALSA_UTILS_APLAYMIDI=y
BR2_PACKAGE_ALSA_UTILS_ARECORDMIDI=y
BR2_PACKAGE_ALSA_UTILS_ASEQDUMP=y
BR2_PACKAGE_ALSA_UTILS_ASEQNET=y
BR2_PACKAGE_ALSA_UTILS_SPEAKER_TEST=y
BR2_PACKAGE_FFMPEG_NONFREE=y
BR2_PACKAGE_FFMPEG_FFPLAY=y
BR2_PACKAGE_FFMPEG_FFSERVER=y
BR2_PACKAGE_GST_FFMPEG=y
BR2_PACKAGE_GST_DSP=y
BR2_PACKAGE_GST_OMAPFB=y
BR2_PACKAGE_GST_PLUGINS_GOOD=y
BR2_PACKAGE_GST_PLUGINS_GOOD_PLUGIN_V4L2=y
BR2_PACKAGE_GST_PLUGINS_BAD=y
BR2_PACKAGE_GST_PLUGINS_BAD_PLUGIN_CAMERABIN=y
BR2_PACKAGE_GST_PLUGINS_BAD_PLUGIN_CAMERABIN2=y
BR2_PACKAGE_GST_PLUGINS_BAD_PLUGIN_DIRECTFB=y
BR2_PACKAGE_MPG123=y
BR2_PACKAGE_MPLAYER=y
BR2_PACKAGE_YAVTA=y
BR2_PACKAGE_GZIP=y
BR2_PACKAGE_GDB=y
BR2_PACKAGE_LTTNG_BABELTRACE=y
BR2_PACKAGE_LTTNG_MODULES=y
BR2_PACKAGE_LTTNG_TOOLS=y
BR2_PACKAGE_MEMSTAT=y
BR2_PACKAGE_NETPERF=y
BR2_PACKAGE_OPROFILE=y
BR2_PACKAGE_STRACE=y
BR2_PACKAGE_WHETSTONE=y
BR2_PACKAGE_PV=y
BR2_PACKAGE_TAR=y
BR2_PACKAGE_DIRECTFB_MULTI=y
BR2_PACKAGE_DIRECTFB_TESTS=y
BR2_PACKAGE_I2C_TOOLS=y
BR2_PACKAGE_MEDIA_CTL=y
BR2_PACKAGE_OPENSSL_BIN=y
BR2_PACKAGE_SQLITE=y
BR2_PACKAGE_SQLITE_READLINE=y
BR2_PACKAGE_LIBCONFIG=y
BR2_PACKAGE_OPENCV=y
BR2_PACKAGE_OPENCV_BUILD_TESTS=y
BR2_PACKAGE_OPENCV_WITH_FFMPEG=y
BR2_PACKAGE_OPENCV_WITH_GSTREAMER=y
BR2_PACKAGE_OPENCV_WITH_JPEG=y
BR2_PACKAGE_OPENCV_WITH_PNG=y
BR2_PACKAGE_OPENCV_WITH_TIFF=y
BR2_PACKAGE_OPENCV_WITH_V4L=y
BR2_PACKAGE_OPENCV_INSTALL_DATA=y
BR2_PACKAGE_LIBV4L_V4L2_COMPLIANCE=y
BR2_PACKAGE_LIBV4L_V4L2_DBG=y
BR2_PACKAGE_BOOST=y
BR2_PACKAGE_BOOST_FILESYSTEM=y
BR2_PACKAGE_BOOST_PROGRAM_OPTIONS=y
BR2_PACKAGE_ICU=y
BR2_PACKAGE_CAN_UTILS=y
BR2_PACKAGE_IPERF=y
BR2_PACKAGE_NETCAT=y
BR2_PACKAGE_OPENSSH=y
BR2_PACKAGE_RSYNC=y
BR2_PACKAGE_TCPDUMP=y
BR2_PACKAGE_BASH=y
BR2_PACKAGE_LOGROTATE=y
BR2_PACKAGE_SCREEN=y
BR2_PACKAGE_MODULE_INIT_TOOLS=y
BR2_PACKAGE_MONIT=y
BR2_PACKAGE_DSP_TOOLS=y
BR2_PACKAGE_NANO=y
BR2_PACKAGE_VIM=y
BR2_TARGET_UBOOT=y
BR2_TARGET_UBOOT_BOARDNAME="omap3_beagle"
BR2_TARGET_UBOOT_FORMAT_IMG=y
BR2_TARGET_UBOOT_SPL=y
BR2_TARGET_UBOOT_SPL_NAME="spl/u-boot-spl.bin"
BR2_LINUX_KERNEL=y
BR2_LINUX_KERNEL_PATCH="board/beagleboard/xm/kernel-patches/"
BR2_LINUX_KERNEL_USE_CUSTOM_CONFIG=y
BR2_LINUX_KERNEL_CUSTOM_CONFIG_FILE="board/beagleboard/xm/linux-3.9.6.config"
BR2_LINUX_KERNEL_UIMAGE_LOADADDR="0x80008000"
```
